## sdkconfig.defaults
```kconfig
CONFIG_BOARD_TYPE_CUSTOM_S3CAM=y
CONFIG_LCD_ST7735_128X160=y
CONFIG_ESPTOOLPY_FLASHSIZE_16MB=y
CONFIG_PARTITION_TABLE_CUSTOM_FILENAME="partitions/v2/16m.csv"
CONFIG_LANGUAGE_EN_US=y
CONFIG_SR_WN_WN9_JARVIS_TTS=y
CONFIG_SR_WN_WN9_SOPHIA_TTS=y
CONFIG_SR_WN_WN9_NIHAOXIAOZHI_TTS=n
```
